/*
 * SPDX-FileCopyrightText: 2022-2026 TII (SSRC) and the Ghaf contributors
 * SPDX-License-Identifier: CC-BY-SA-4.0
 */

/dts-v1/;
/plugin/;

/ {
    overlay-name = "DCE host proxy";
    compatible = "nvidia,tegra234";

    fragment@0 {
        target-path = "/";

        __overlay__ {
            dce_host_proxy: dce_host_proxy {
                compatible = "nvidia,dce-host-proxy";
                status = "okay";
            };
        };
    };
};
